## conf/layer.conf
```bitbake
# We have a conf and classes directory, add to BBPATH
BBPATH .= ":${LAYERDIR}"

# We have recipes-* directories, add to BBFILES
BBFILES += "${LAYERDIR}/recipes-*/*/*.bb \
            ${LAYERDIR}/recipes-*/*/*.bbappend"

BBFILE_COLLECTIONS += "meta-devon"
BBFILE_PATTERN_meta-devon = "^${LAYERDIR}/"
BBFILE_PRIORITY_meta-devon = "6"

LAYERDEPENDS_meta-devon = "core"
LAYERSERIES_COMPAT_meta-devon = "dunfell"
```
